/* USER CODE BEGIN Header */
/**
  ******************************************************************************
  * @file           : main.c
  * @brief          : Main program body
  ******************************************************************************
  * @attention
  *
  * Copyright (c) 2025 STMicroelectronics.
  * All rights reserved.
  *
  * This software is licensed under terms that can be found in the LICENSE file
  * in the root directory of this software component.
  * If no LICENSE file comes with this software, it is provided AS-IS.
  *
  ******************************************************************************
  */
/* USER CODE END Header */
/* Includes ------------------------------------------------------------------*/
#include "main.h"

/* Private includes ----------------------------------------------------------*/
/* USER CODE BEGIN Includes */

/* USER CODE END Includes */

/* Private typedef -----------------------------------------------------------*/
/* USER CODE BEGIN PTD */

/* USER CODE END PTD */

/* Private define ------------------------------------------------------------*/
/* USER CODE BEGIN PD */

/* USER CODE END PD */

/* Private macro -------------------------------------------------------------*/
/* USER CODE BEGIN PM */
#define RCC_BASE_ADDR 0x40021000UL
#define RCC_APB2ENR_OFFSET 0x18UL

#define RCC_APB2ENR  (RCC_BASE_ADDR + RCC_APB2ENR_OFFSET)

#define GPIOA_BASE_ADDR 0x40010800UL
#define GPIOA_CRH_OFFSET    0x04UL
#define GPIOA_ODR_OFFSET    0X0CUL


#define GPIOA_ODR_ADDR 			(GPIOA_BASE_ADDR + GPIOA_ODR_OFFSET)
#define GPIOA_CRH_ADDR        	(GPIOA_BASE_ADDR + GPIOA_CRH_OFFSET)

/* USER CODE END PM */

/* Private variables ---------------------------------------------------------*/

/* USER CODE BEGIN PV */

/* USER CODE END PV */

/* Private function prototypes -----------------------------------------------*/
void SystemClock_Config(void);
/* USER CODE BEGIN PFP */

/* USER CODE END PFP */

/* Private user code ---------------------------------------------------------*/
/* USER CODE BEGIN 0 */
void delay(void)
{
    for (volatile uint32_t i = 0; i < 100000; i++) {
        // Just looping for time delay
    }
}
/* USER CODE END 0 */

/**
  * @brief  The application entry point.
  * @retval int
  */
int main(void)
{

  /* USER CODE BEGIN 1 */
volatile uint32_t *ptrRccApb2Enr = (volatile uint32_t*) RCC_APB2ENR;
*ptrRccApb2Enr |= (1<<2);

volatile uint32_t *ptrGpioaOdr = (volatile uint32_t *)GPIOA_ODR_ADDR;

volatile uint32_t *ptrGpioaCrh = (volatile uint32_t *)GPIOA_CRH_ADDR;
*ptrGpioaCrh &= ~(0xF << 0);   // Clear MODE8[1:0] and CNF8[1:0]
*ptrGpioaCrh |=  (0x2 << 0);   // MODE8 = 10 (Output 2MHz), CNF8 = 00 (Push-pull)
  /* USER CODE END 1 */

  /* MCU Configuration--------------------------------------------------------*/

  /* Reset of all peripherals, Initializes the Flash interface and the Systick. */


  /* USER CODE BEGIN Init */

  /* USER CODE END Init */

  /* Configure the system clock */


  /* USER CODE BEGIN SysInit */

  /* USER CODE END SysInit */

  /* Initialize all configured peripherals */
  /* USER CODE BEGIN 2 */

  /* USER CODE END 2 */

  /* Infinite loop */
  /* USER CODE BEGIN WHILE */
  while (1)
  {
    /* USER CODE END WHILE */
*ptrGpioaOdr |=  (1 << 8);  // Set PA8
	delay();
*ptrGpioaOdr &= ~(1 << 8);  // Clear PA8
	delay();
    /* USER CODE BEGIN 3 */
  }
  /* USER CODE END 3 */
}

/**
  * @brief System Clock Configuration
  * @retval None
  */
void SystemClock_Config(void)
{
  /* HAL-based clock configuration generated by CubeIDE is not used.
   * The example runs at the default HSI clock without calling HAL. */
}

/* USER CODE BEGIN 4 */

/* USER CODE END 4 */

/**
  * @brief  This function is executed in case of error occurrence.
  * @retval None
  */
void Error_Handler(void)
{
  /* USER CODE BEGIN Error_Handler_Debug */
  /* User can add his own implementation to report the HAL error return state */
  __disable_irq();
  while (1)
  {
  }
  /* USER CODE END Error_Handler_Debug */
}

#ifdef  USE_FULL_ASSERT
/**
  * @brief  Reports the name of the source file and the source line number
  *         where the assert_param error has occurred.
  * @param  file: pointer to the source file name
  * @param  line: assert_param error line source number
  * @retval None
  */
void assert_failed(uint8_t *file, uint32_t line)
{
  /* USER CODE BEGIN 6 */
  /* User can add his own implementation to report the file name and line number,
     ex: printf("Wrong parameters value: file %s on line %d\r\n", file, line) */
  /* USER CODE END 6 */
}
#endif /* USE_FULL_ASSERT */
