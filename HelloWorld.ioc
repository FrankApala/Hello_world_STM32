# file: HelloWorld.ioc
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Mcu.Family=STM32F1
Mcu.Name=STM32F103R(8-B)Tx
Mcu.Package=LQFP64
NVIC.PriorityGroup=NVIC_PRIORITYGROUP_4
ProjectManager.HeapSize=0x200
ProjectManager.StackSize=0x400
ProjectManager.TargetToolchain=STM32CubeIDE
RCC.APB1Freq_Value=8000000
RCC.APB2Freq_Value=8000000
board=custom

// file: Core/Src/main.c
/* USER CODE BEGIN Header */
/**
  ******************************************************************************
  * @file           : main.c
  * @brief          : Main program body
  ******************************************************************************
  * @attention
  *
  * Copyright (c) 2025 STMicroelectronics.
  * All rights reserved.
  *
  * This software is licensed under terms that can be found in the LICENSE file
  * in the root directory of this software component.
  * If no LICENSE file comes with this software, it is provided AS-IS.
  *
  ******************************************************************************
  */
/* USER CODE END Header */
#include "main.h"

/* USER CODE BEGIN PM */
#define RCC_BASE_ADDR 0x40021000UL
#define RCC_APB2ENR_OFFSET 0x18UL

#define RCC_APB2ENR  (RCC_BASE_ADDR + RCC_APB2ENR_OFFSET)

#define GPIOA_BASE_ADDR 0x40010800UL
#define GPIOA_CRH_OFFSET    0x04UL
#define GPIOA_ODR_OFFSET    0X0CUL

#define GPIOA_ODR_ADDR 			(GPIOA_BASE_ADDR + GPIOA_ODR_OFFSET)
#define GPIOA_CRH_ADDR        	(GPIOA_BASE_ADDR + GPIOA_CRH_OFFSET)

/* USER CODE END PM */

void SystemClock_Config(void);

/* USER CODE BEGIN 0 */
void delay(void)
{
    for (volatile uint32_t i = 0; i < 100000; i++) {
        // Just looping for time delay
    }
}
/* USER CODE END 0 */

int main(void)
{

  /* USER CODE BEGIN 1 */
volatile uint32_t *ptrRccApb2Enr = (volatile uint32_t*) RCC_APB2ENR;
*ptrRccApb2Enr |= (1<<2);

volatile uint32_t *ptrGpioaOdr = (volatile uint32_t *)GPIOA_ODR_ADDR;

volatile uint32_t *ptrGpioaCrh = (volatile uint32_t *)GPIOA_CRH_ADDR;
*ptrGpioaCrh &= ~(0xF << 0);   // Clear MODE8[1:0] and CNF8[1:0]
*ptrGpioaCrh |=  (0x2 << 0);   // MODE8 = 10 (Output 2MHz), CNF8 = 00 (Push-pull)
  /* USER CODE END 1 */

  /* MCU Configuration--------------------------------------------------------*/

  /* Reset of all peripherals, Initializes the Flash interface and the Systick. */

  /* Configure the system clock */

  /* Initialize all configured peripherals */

  /* Infinite loop */
  while (1)
  {
*ptrGpioaOdr |=  (1 << 8);  // Set PA8
	delay();
*ptrGpioaOdr &= ~(1 << 8);  // Clear PA8
	delay();
  }
}

void SystemClock_Config(void)
{
  /* HAL-based clock configuration generated by CubeIDE is not used.
   * The example runs at the default HSI clock without calling HAL. */
}

void Error_Handler(void)
{
  __disable_irq();
  while (1)
  {
  }
}
